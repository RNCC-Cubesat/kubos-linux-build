## package/kubos/kubos-pumpkin-mcu/Config.in
```kconfig
menuconfig BR2_PACKAGE_KUBOS_PUMPKIN_MCU
    bool "Pumpkin MCU Service"
    default n
    depends on BR2_PACKAGE_PYTHON3
    select BR2_PACKAGE_PYTHON_GRAPHENE
    select BR2_PACKAGE_KUBOS_SERVICE_LIB
    select BR2_PACKAGE_KUBOS_HAL_I2C
    help
        Include the Pumpkin MCU Kubos Service.
        
if BR2_PACKAGE_KUBOS_PUMPKIN_MCU

config BR2_KUBOS_PUMPKIN_MCU_INIT_LVL
    int "Service Init Run Level"
    default 20
    range 10 99
    depends on BR2_PACKAGE_KUBOS_PUMPKIN_MCU
    help
        The initialization priority level of the Pumpkin MCU Kubos service.
        The lower the number, the earlier the service is initialized.

config BR2_KUBOS_PUMPKIN_MCU_IP
    string "Service IP Address"
    default "0.0.0.0"
    depends on BR2_PACKAGE_KUBOS_PUMPKIN_MCU
    help
        The IP address which the service should use to receive GraphQL requests

config BR2_KUBOS_PUMPKIN_MCU_BUS_PATH
    string "Bus Definition Path"
    default "/home/system/etc/bus.json"
    depends on BR2_PACKAGE_KUBOS_PUMPKIN_MCU
    help
        The path to the bus definition JSON file (generated from pumqry)
        
config BR2_KUBOS_PUMPKIN_MCU_PORT
    int "Service Port"
    default 8150
    depends on BR2_PACKAGE_KUBOS_PUMPKIN_MCU
    help
        The port which the service should use to receive GraphQL requests

endif
```

## package/mission/Config.in
```kconfig
# Create base `mission` option in config menu
menuconfig BR2_PACKAGE_MISSION
	bool "Mission Packages"
	default y
	help
		Enable Mission services and libraries

if BR2_PACKAGE_MISSION
	
	config BR2_MISSION_VERSION
		string "Mission Branch Source Version"
		default "master"
		help
			Release, tag, or branch of the Mission repo to use when building Mission
			packages

    
    source "$BR2_EXTERNAL_KUBOS_LINUX_PATH/package/mission/python-mission-app/Config.in"
    source "$BR2_EXTERNAL_KUBOS_LINUX_PATH/package/mission/rust-mission-app/Config.in"
endif
```

## package/mission/python-mission-app/Config.in
```kconfig
menuconfig BR2_PACKAGE_PYTHON_MISSION_APP
    bool "Python Mission App"
    default n
    depends on BR2_PACKAGE_PYTHON3
    select BR2_PACKAGE_PYTHON_GRAPHENE
    select BR2_PACKAGE_KUBOS_SERVICE_LIB
    help
        Include the Example Python Mission App
        
if BR2_PACKAGE_PYTHON_MISSION_APP

config BR2_PYTHON_MISSION_APP_INIT_LVL
    int "Mission App Init Run Level"
    default 20
    range 10 99
    depends on BR2_PACKAGE_PYTHON_MISSION_APP
    help
        The initialization priority level of the Python Mission app.
        The lower the number, the earlier the service is initialized.

config BR2_PYTHON_MISSION_APP_IP
    string "Mission App IP Address"
    default "0.0.0.0"
    depends on BR2_PACKAGE_PYTHON_MISSION_APP
    help
        The IP address which the service should use to receive GraphQL requests

config BR2_PYTHON_MISSION_APP_STRING_VAR
    string "String Var"
    default "/path/to/hello/world"
    depends on BR2_PACKAGE_PYTHON_MISSION_APP
    help
        An example string variable for the mission app
        
config BR2_PYTHON_MISSION_APP_PORT
    int "Mission app Port"
    default 8150
    depends on BR2_PACKAGE_PYTHON_MISSION_APP
    help
        The port which the service should use to receive GraphQL requests

endif
```

## package/mission/rust-mission-app/Config.in
```kconfig
menuconfig BR2_PACKAGE_RUST_MISSION_APP
    bool "Rust Mission app"
    default n
    select BR2_PACKAGE_HAS_RUST_MISSION_APP
    help
        Include Rust Mission App.

if BR2_PACKAGE_RUST_MISSION_APP

config BR2_RUST_MISSION_APP_INIT_LVL
    int "Rust Mission App Run Level"
    default 90
    range 10 99
    depends on BR2_PACKAGE_RUST_MISSION_APP
    help
        The initialization priority level of the Rust Mission App.
        The lower the number, the earlier the service is initialized.

config BR2_RUST_MISSION_APP_RESTART_COUNT
    int "Service Restart Limit"
    default 3
    depends on BR2_PACKAGE_RUST_MISSION_APP
    depends on BR2_PACKAGE_MONIT
    help
        The maximum number of times the service should be restarted within the timeframe
        specified by BR2_RUST_MISSION_APP_RESTART_CYCLES if it goes down

config BR2_RUST_MISSION_APP_RESTART_CYCLES
    int "Service Restart Limit Timeframe"
    default 10
    depends on BR2_PACKAGE_RUST_MISSION_APP
    depends on BR2_PACKAGE_MONIT
    help
        The number of Monit monitoring cycles in which the maximum number of service restarts
        must occur before the system stops trying to recover the service.
        
        The resulting maximum timeframe in which the restarts must occur can be calculated by
        multiplying this number by the length of a single Monit sleep cycle (60 seconds)
 
config BR2_RUST_MISSION_APP_IP
    string "Service IP Address"
    default "0.0.0.0"
    depends on BR2_PACKAGE_RUST_MISSION_APP
    help
        The IP address which the service should use to receive GraphQL requests
        
config BR2_RUST_MISSION_APP_PORT
    int "Service Port"
    default 8120
    depends on BR2_PACKAGE_RUST_MISSION_APP
    help
        The port which the service should use to receive GraphQL requests
        
endif

config BR2_PACKAGE_HAS_RUST_MISSION_APP
    bool

config BR2_PACKAGE_PROVIDES_RUST_MISSION_APP
    string
    default "kubos"
```

## package/python/Config.in
```kconfig
menu "Additional Python Packages"
    source "$BR2_EXTERNAL_KUBOS_LINUX_PATH/package/python/python-aniso8601/Config.in"
    source "$BR2_EXTERNAL_KUBOS_LINUX_PATH/package/python/python-flask_graphql/Config.in"
	source "$BR2_EXTERNAL_KUBOS_LINUX_PATH/package/python/python-graphene/Config.in"
	source "$BR2_EXTERNAL_KUBOS_LINUX_PATH/package/python/python-graphql-core/Config.in"
	source "$BR2_EXTERNAL_KUBOS_LINUX_PATH/package/python/python-graphql-relay/Config.in"
	source "$BR2_EXTERNAL_KUBOS_LINUX_PATH/package/python/python-promise/Config.in"
	source "$BR2_EXTERNAL_KUBOS_LINUX_PATH/package/python/python-rx/Config.in"
	source "$BR2_EXTERNAL_KUBOS_LINUX_PATH/package/python/python-pumpkin-supmcu/Config.in"
	source "$BR2_EXTERNAL_KUBOS_LINUX_PATH/package/python/python-pumpkin-supmcu-kubos/Config.in"
	source "$BR2_EXTERNAL_KUBOS_LINUX_PATH/package/python/python-putdig-cli/Config.in"
	source "$BR2_EXTERNAL_KUBOS_LINUX_PATH/package/python/python-putdig-common/Config.in"
	source "$BR2_EXTERNAL_KUBOS_LINUX_PATH/package/python/python-putdig/Config.in"
	source "$BR2_EXTERNAL_KUBOS_LINUX_PATH/package/python/python-plumbum/Config.in"
	source "$BR2_EXTERNAL_KUBOS_LINUX_PATH/package/python/python-waitress/Config.in"
	source "$BR2_EXTERNAL_KUBOS_LINUX_PATH/package/python/python-flask-wtf/Config.in"
endmenu
```

## package/python/python-flask-wtf/Config.in
```kconfig
config BR2_PACKAGE_PYTHON_FLASK_WTF
	bool "python-flask-wtf"
	
	select BR2_PACKAGE_PYTHON_WTFORMS # runtime
	select BR2_PACKAGE_PYTHON_ITSDANGEROUS # runtime
	help
	  Simple integration of Flask and WTForms, including CSRF, file upload, and reCAPTCHA.

	  https://github.com/lepture/flask-wtf
```

## package/python/python-plumbum/Config.in
```kconfig
config BR2_PACKAGE_PYTHON_PLUMBUM
	bool "python-plumbum"
	default n
	select BR2_PACKAGE_PYTHON_PARAMIKO # runtime
	help
	  Adds Plumbum CLI combinators and more!

	  https://plumbum.readthedocs.io/en/latest/
```

## package/python/python-pumpkin-supmcu-kubos/Config.in
```kconfig
config BR2_PACKAGE_PYTHON_PUMPKIN_SUPMCU_KUBOS
	bool "python-pumpkin-supmcu-kubos"
	select BR2_PACKAGE_PYTHON_PUMPKIN_SUPMCU
	help
	  pumpkin-supmcu-kubos package for interfacing with Pumpkin SupMCU Modules via KubOS I2C HAL

	  https://gitlab.com/pumpkin-space-systems/public/pumpkin-supmcu-kubos.git
```

## package/python/python-pumpkin-supmcu/Config.in
```kconfig
config BR2_PACKAGE_PYTHON_PUMPKIN_SUPMCU
	bool "python-pumpkin-supmcu"
	help
	  pumpkin-supmcu package for interfacing with Pumpkin SupMCU Modules

	  https://gitlab.com/pumpkin-space-systems/public/pumpkin_supmcu.git
```

## package/python/python-putdig-cli/Config.in
```kconfig
config BR2_PACKAGE_PYTHON_PUTDIG_CLI
	bool "python-putdig-cli"
	select BR2_PACKAGE_PYTHON_PUTDIG_COMMON
	select BR2_PACKAGE_PYTHON_PLUMBUM
	help
	  putdig-cli package for discovering, injecting and generating telemetry for RS3 modules.
```

## package/python/python-putdig-common/Config.in
```kconfig
config BR2_PACKAGE_PYTHON_PUTDIG_COMMON
	bool "python-putdig-common"
	select BR2_PACKAGE_PYTHON_PUMPKIN_SUPMCU_KUBOS
	help
	  putdig-common package for PuTDIG-CLI
```

## package/python/python-putdig/Config.in
```kconfig
config BR2_PACKAGE_PYTHON_PUTDIG
	bool "python-putdig"
	select BR2_PACKAGE_PYTHON_PUTDIG_COMMON
	select BR2_PACKAGE_PYTHON_PLUMBUM
	select BR2_PACKAGE_PYTHON_FLASK_WTF
	select BR2_PACKAGE_PYTHON_FLASK
	select BR2_PACKAGE_PYTHON_WAITRESS

	help
	  putdig package for discovering, injecting and generating telemetry for RS3 modules via web interface.
```

## package/python/python-waitress/Config.in
```kconfig
config BR2_PACKAGE_PYTHON_WAITRESS
	bool "python-waitress"

	help
	  Waitress is meant to be a production-quality pure-Python WSGI server with very acceptable performance.
	  It has no dependencies except ones which live in the Python standard library.

	  https://github.com/Pylons/waitress
```
